## kernel/linux-5.4/Documentation/devicetree/bindings/arm/rda.yaml
```yaml
# SPDX-License-Identifier: GPL-2.0
%YAML 1.2
---
$id: http://devicetree.org/schemas/arm/rda.yaml#
$schema: http://devicetree.org/meta-schemas/core.yaml#

title: RDA Micro platforms device tree bindings

maintainers:
  - Manivannan Sadhasivam <manivannan.sadhasivam@linaro.org>

properties:
  compatible:
    items:
      - enum:
          - xunlong,pbsbc01h3-2g-iot     # pbsbc01h3 2G-IoT
          - xunlong,pbsbc01h3-i96        # pbsbc01h3 i96
      - const: rda,8810pl

...
```
